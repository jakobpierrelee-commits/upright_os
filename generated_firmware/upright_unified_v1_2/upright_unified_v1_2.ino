/*
  upright_unified_v1_2
  Unified UpRight firmware scaffold
  Generated by UpRight.os

  Profile: UpRight Unified
  FQBN: arduino:avr:nano

  This scaffold implements the serial command and STATUS telemetry contract used by UpRight UI.
  Replace sensor/motor stubs with your board-specific logic.
*/

#include <Arduino.h>
#include <math.h>
#include "config_board.h"

// Contract state
static float g_kp = 31.0f;
static float g_ki = 0.05f;
static float g_kd = 1.05f;
static float g_kv = 0.0f;
static float g_kx = 0.0f;
static float g_set = 0.0f;
static float g_out = 0.0f;

static float g_ang = 0.0f;   // filtered angle (deg)
static float g_raw = 0.0f;   // accel angle (deg)
static float g_gyro = 0.0f;  // rate (dps)

// Signal -> Error -> Output diagnostics
static float g_pid_err = 0.0f;
static float g_pid_p = 0.0f;
static float g_pid_i = 0.0f;
static float g_pid_d = 0.0f;
static float g_pid_u_unsat = 0.0f;
static float g_pid_u_sat = 0.0f;
static bool g_output_saturated = false;

// Safety/limits
static float g_out_max = 180.0f;
static float g_tip_deg = 35.0f;
static float g_i_max = 70.0f;
static bool g_conditional_i = true;

// Basic low-pass filter control for gyro path
static float g_lpf_cutoff_hz = 8.0f;
static bool g_gyro_lpf_init = false;
static float g_gyro_lpf = 0.0f;

// 2-state Kalman (angle + gyro bias)
static float g_kf_angle = 0.0f;
static float g_kf_bias = 0.0f;
static float g_kf_P00 = 1.0f;
static float g_kf_P01 = 0.0f;
static float g_kf_P10 = 0.0f;
static float g_kf_P11 = 1.0f;
static float g_kf_q_angle = 0.001f;
static float g_kf_q_bias = 0.003f;
static float g_kf_r_measure = 0.03f;
static float g_kal_innov = 0.0f;

// v2 calibration/anti-drift contract fields (factory standard)
static float g_gyro_bias = 0.0f;
static float g_accel_level_offset = 0.0f;
static float g_upright_trim = 0.0f;
static float g_vel_meas = 0.0f;
static float g_vel_target = 0.0f;
static bool g_outer_loop_enabled = false;
static float g_target_angle_from_velocity = 0.0f;
static float g_motor_l_trim = 1.0f;
static float g_motor_r_trim = 1.0f;
static const char* g_drift_diag_state = "unknown";

static bool g_armed = false;
static bool g_estop = false;
static uint32_t g_last_status_ms = 0;
static uint32_t g_last_loop_us = 0;
static float g_integral_accum = 0.0f;
static float g_prev_err = 0.0f;

static float clampf(float v, float lo, float hi) {
  if (v < lo) return lo;
  if (v > hi) return hi;
  return v;
}

static float alphaFromCutoffHz(float cutoff_hz, float dt_s) {
  if (cutoff_hz <= 0.0f || dt_s <= 0.0f) return 1.0f;
  const float tau = 1.0f / (2.0f * PI * cutoff_hz);
  return dt_s / (tau + dt_s);
}

static float lpfGyro(float gyro_meas, float dt_s) {
  if (!g_gyro_lpf_init) {
    g_gyro_lpf = gyro_meas;
    g_gyro_lpf_init = true;
    return g_gyro_lpf;
  }
  const float a = alphaFromCutoffHz(g_lpf_cutoff_hz, dt_s);
  g_gyro_lpf += a * (gyro_meas - g_gyro_lpf);
  return g_gyro_lpf;
}

static void kalmanUpdate(float accel_angle_deg, float gyro_rate_dps, float dt_s) {
  if (dt_s <= 0.0f) dt_s = 0.01f;

  // Predict
  const float rate = gyro_rate_dps - g_kf_bias;
  g_kf_angle += dt_s * rate;

  g_kf_P00 += dt_s * (dt_s * g_kf_P11 - g_kf_P01 - g_kf_P10 + g_kf_q_angle);
  g_kf_P01 -= dt_s * g_kf_P11;
  g_kf_P10 -= dt_s * g_kf_P11;
  g_kf_P11 += g_kf_q_bias * dt_s;

  // Correct
  g_kal_innov = accel_angle_deg - g_kf_angle;
  const float S = g_kf_P00 + g_kf_r_measure;
  if (S <= 1e-9f) return;

  const float K0 = g_kf_P00 / S;
  const float K1 = g_kf_P10 / S;

  g_kf_angle += K0 * g_kal_innov;
  g_kf_bias += K1 * g_kal_innov;

  const float P00_tmp = g_kf_P00;
  const float P01_tmp = g_kf_P01;
  g_kf_P00 -= K0 * P00_tmp;
  g_kf_P01 -= K0 * P01_tmp;
  g_kf_P10 -= K1 * P00_tmp;
  g_kf_P11 -= K1 * P01_tmp;
}

// TODO: replace these sensor stubs with real IMU reads.
static float readAccelAngleDegStub() {
  return 0.0f;
}

static float readGyroRateDpsStub() {
  return 0.0f;
}

static void updateTelemetryStub(float dt_s) {
  // Keep scaffold deterministic until user adds hardware reads.
  g_raw = readAccelAngleDegStub() + g_accel_level_offset;
  const float gyro_meas = readGyroRateDpsStub() - g_gyro_bias;
  g_gyro = lpfGyro(gyro_meas, dt_s);

  kalmanUpdate(g_raw, g_gyro, dt_s);
  g_ang = g_kf_angle + g_upright_trim;

  // v2 placeholders until real calibration + outer-loop paths are wired.
  g_vel_meas = 0.0f;
  g_vel_target = 0.0f;
  g_outer_loop_enabled = false;
  g_target_angle_from_velocity = 0.0f;
}

// TODO: replace with your real motor output path.
static void applyControlStub(float out) {
  (void)out;
  // Example only: no hardware writes here.
}

static void emitStatus() {
  Serial.print("STATUS mode=");
  Serial.print(g_armed ? "BALANCING" : "SAFE_IDLE");
  Serial.print(" estop=");
  Serial.print(g_estop ? "1" : "0");
  Serial.print(" ang=");
  Serial.print(g_ang, 3);
  Serial.print(" raw=");
  Serial.print(g_raw, 3);
  Serial.print(" gyro=");
  Serial.print(g_gyro, 3);
  Serial.print(" set=");
  Serial.print(g_set, 3);
  Serial.print(" out=");
  Serial.print(g_out, 3);
  Serial.print(" kp=");
  Serial.print(g_kp, 4);
  Serial.print(" ki=");
  Serial.print(g_ki, 4);
  Serial.print(" kd=");
  Serial.print(g_kd, 4);
  Serial.print(" kv=");
  Serial.print(g_kv, 4);
  Serial.print(" kx=");
  Serial.print(g_kx, 4);
  Serial.print(" pid_err=");
  Serial.print(g_pid_err, 4);
  Serial.print(" pid_p=");
  Serial.print(g_pid_p, 4);
  Serial.print(" pid_i=");
  Serial.print(g_pid_i, 4);
  Serial.print(" pid_d=");
  Serial.print(g_pid_d, 4);
  Serial.print(" pid_u_unsat=");
  Serial.print(g_pid_u_unsat, 4);
  Serial.print(" pid_u_sat=");
  Serial.print(g_pid_u_sat, 4);
  Serial.print(" output_saturated=");
  Serial.print(g_output_saturated ? "1" : "0");
  Serial.print(" kal_innov=");
  Serial.print(g_kal_innov, 4);
  Serial.print(" out_max=");
  Serial.print(g_out_max, 2);
  Serial.print(" tip_deg=");
  Serial.print(g_tip_deg, 2);
  Serial.print(" i_max=");
  Serial.print(g_i_max, 2);
  Serial.print(" lpf_cutoff_hz=");
  Serial.print(g_lpf_cutoff_hz, 2);
  Serial.print(" conditional_i=");
  Serial.print(g_conditional_i ? "1" : "0");
  Serial.print(" gyro_bias=");
  Serial.print(g_gyro_bias, 6);
  Serial.print(" accel_level_offset=");
  Serial.print(g_accel_level_offset, 6);
  Serial.print(" upright_trim=");
  Serial.print(g_upright_trim, 6);
  Serial.print(" vel_meas=");
  Serial.print(g_vel_meas, 4);
  Serial.print(" vel_target=");
  Serial.print(g_vel_target, 4);
  Serial.print(" outer_loop_enabled=");
  Serial.print(g_outer_loop_enabled ? "1" : "0");
  Serial.print(" target_angle_from_velocity=");
  Serial.print(g_target_angle_from_velocity, 4);
  Serial.print(" motor_l_trim=");
  Serial.print(g_motor_l_trim, 4);
  Serial.print(" motor_r_trim=");
  Serial.print(g_motor_r_trim, 4);
  Serial.print(" drift_diag_state=");
  Serial.print(g_drift_diag_state);
  Serial.print(" wpos=0 wspd=0 encL=0 encR=0 volRaw=0");
  Serial.println();
}

static bool parsePID(const String& s) {
  float kp, ki, kd;
  if (sscanf(s.c_str(), "PID %f %f %f", &kp, &ki, &kd) == 3) {
    g_kp = kp;
    g_ki = ki;
    g_kd = kd;
    Serial.println("OK PID");
    return true;
  }
  return false;
}

static bool parseMotion(const String& s) {
  float kv, kx;
  if (sscanf(s.c_str(), "MOTION %f %f", &kv, &kx) == 2) {
    g_kv = kv;
    g_kx = kx;
    Serial.println("OK MOTION");
    return true;
  }
  return false;
}

static bool parseSetpoint(const String& s) {
  float deg;
  if (sscanf(s.c_str(), "SETPOINT %f", &deg) == 1) {
    g_set = deg;
    Serial.println("OK SETPOINT");
    return true;
  }
  return false;
}

static bool parseLimits(const String& s) {
  float out_max, tip_deg, i_max;
  if (sscanf(s.c_str(), "LIMITS %f %f %f", &out_max, &tip_deg, &i_max) == 3) {
    g_out_max = clampf(out_max, 20.0f, 255.0f);
    g_tip_deg = clampf(tip_deg, 5.0f, 60.0f);
    g_i_max = clampf(i_max, 1.0f, 500.0f);
    Serial.println("OK LIMITS");
    return true;
  }
  return false;
}

static bool parseFilter(const String& s) {
  float cutoff_hz;
  int conditional_i;
  if (sscanf(s.c_str(), "FILTER %f %d", &cutoff_hz, &conditional_i) == 2) {
    g_lpf_cutoff_hz = clampf(cutoff_hz, 0.1f, 80.0f);
    g_conditional_i = conditional_i != 0;
    Serial.println("OK FILTER");
    return true;
  }
  return false;
}

static void handleCommand(const String& cmdRaw) {
  String cmd = cmdRaw;
  cmd.trim();
  if (cmd.length() == 0) return;

  if (cmd == "GET") {
    emitStatus();
    return;
  }
  if (cmd == "HELP") {
    Serial.println("OK HELP GET ARM DISARM CAL ZERO SAVECFG PID MOTION SETPOINT LIMITS FILTER BURSTCSV LOGCSV LOGT IDENT");
    return;
  }
  if (cmd == "IDENT") {
    Serial.println("UPRIGHT_UNIFIED_V1");
    return;
  }
  if (cmd == "ARM") {
    g_armed = true;
    g_integral_accum = 0.0f;
    g_prev_err = 0.0f;
    Serial.println("OK ARM");
    return;
  }
  if (cmd == "DISARM") {
    g_armed = false;
    g_out = 0.0f;
    applyControlStub(0.0f);
    Serial.println("OK DISARM");
    return;
  }
  if (cmd == "CAL ZERO") {
    // TODO: write your IMU zero routine.
    g_accel_level_offset = -g_raw;
    g_upright_trim = 0.0f;
    Serial.println("OK CAL ZERO");
    return;
  }
  if (cmd == "SAVECFG") {
    // TODO: persist config in EEPROM/flash.
    Serial.println("OK SAVECFG");
    return;
  }
  if (parsePID(cmd) || parseMotion(cmd) || parseSetpoint(cmd) || parseLimits(cmd) || parseFilter(cmd)) {
    return;
  }
  if (cmd.startsWith("BURSTCSV ")) {
    Serial.println("OK BURSTCSV");
    return;
  }
  if (cmd == "LOGCSV" || cmd == "LOGT") {
    Serial.println("OK LOG");
    return;
  }

  Serial.print("ERR UNKNOWN ");
  Serial.println(cmd);
}

void setup() {
  Serial.begin(115200);
  delay(120);
  Serial.println("UPRIGHT_UNIFIED_BOOT");

  pinMode(PIN_LED, OUTPUT);
  digitalWrite(PIN_LED, LOW);
  g_last_loop_us = micros();
}

void loop() {
  while (Serial.available() > 0) {
    String cmd = Serial.readStringUntil('\n');
    handleCommand(cmd);
  }

  uint32_t now_us = micros();
  float dt_s = (now_us - g_last_loop_us) / 1000000.0f;
  g_last_loop_us = now_us;
  if (dt_s <= 0.0f || dt_s > 0.2f) dt_s = 0.01f;

  updateTelemetryStub(dt_s);

  if (g_armed && !g_estop) {
    if (fabs(g_ang) > g_tip_deg) {
      g_estop = true;
      g_armed = false;
      g_out = 0.0f;
      applyControlStub(0.0f);
    } else {
      g_pid_err = g_set - g_ang;
      g_pid_p = g_kp * g_pid_err;
      g_pid_d = g_kd * ((g_pid_err - g_prev_err) / dt_s);

      const bool integrate_now = (!g_conditional_i) || (!g_output_saturated) || (g_pid_err * g_pid_u_sat < 0.0f);
      if (integrate_now) {
        g_integral_accum += g_pid_err * dt_s;
        g_integral_accum = clampf(g_integral_accum, -g_i_max, g_i_max);
      }
      g_pid_i = g_ki * g_integral_accum;

      // Optional motion feed-forward hooks.
      const float motion_term = (g_kv * g_vel_target) + (g_kx * g_target_angle_from_velocity);

      g_pid_u_unsat = g_pid_p + g_pid_i + g_pid_d + motion_term;
      g_pid_u_sat = clampf(g_pid_u_unsat, -g_out_max, g_out_max);
      g_output_saturated = fabs(g_pid_u_unsat - g_pid_u_sat) > 0.001f;

      g_out = g_pid_u_sat;
      applyControlStub(g_out);
      g_prev_err = g_pid_err;
    }
  } else {
    g_out = 0.0f;
    g_pid_err = 0.0f;
    g_pid_p = 0.0f;
    g_pid_i = 0.0f;
    g_pid_d = 0.0f;
    g_pid_u_unsat = 0.0f;
    g_pid_u_sat = 0.0f;
    g_output_saturated = false;
  }

  const uint32_t now = millis();
  if (now - g_last_status_ms >= 90) {
    g_last_status_ms = now;
    emitStatus();
    digitalWrite(PIN_LED, !digitalRead(PIN_LED));
  }
}
